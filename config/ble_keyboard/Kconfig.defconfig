## config/ble_keyboard/Kconfig.defconfig
```kconfig
if SHIELD_BLE_KEYBOARD

# Name must be less than 16 characters long!
config ZMK_KEYBOARD_NAME
    default "BLE Keyboard"

endif
```

## config/boards/shields/ble_keyboard/Kconfig.shield
```kconfig
# No whitespace after the comma or in your keyboard name!
config SHIELD_BLE_KEYBOARD
    def_bool $(shields_list_contains,ble_keyboard)
```
